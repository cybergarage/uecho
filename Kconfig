## Kconfig
```kconfig
menu "uEcho"

    config UECHO_THREAD_STACK_SIZE
        int "uEcho worker stack size (bytes)"
        range 4096 65536
        default 8192
        help
            Stack allocated for each uEcho pthread. A node runs one unicast and
            one multicast receiver per network interface, and message and
            property listeners are called on these workers. Increase this for
            application callbacks with large stack usage, and measure the stack
            high-water mark on your hardware.

    choice UECHO_DATABASE
        prompt "Standard object database"
        default UECHO_DATABASE_FULL
        help
            The standard object database holds the ECHONET Lite object, property
            and manufacturer definitions from the MRA. It is a const table in
            flash, so it uses no heap.

        config UECHO_DATABASE_FULL
            bool "Full"
            help
                All standard objects and manufacturer codes. Objects get the
                standard properties of their class automatically, and object,
                property and manufacturer names are available.

        config UECHO_DATABASE_NONE
            bool "None"
            help
                Only the super class and the node profile class, which uEcho
                needs itself. Saves about 45 KB of flash. Device objects get only
                the super class properties and the properties you add, standard
                names other than these two classes are not available, and
                uecho_database_getmanufacture() always returns NULL.
    endchoice

endmenu
```

## examples/espidf/uecholight/main/Kconfig.projbuild
```kconfig
menu "uEcho light example"

    config UECHO_EXAMPLE_WIFI_SSID
        string "Wi-Fi SSID"
        default ""

    config UECHO_EXAMPLE_WIFI_PASSWORD
        string "Wi-Fi password"
        default ""
        help
            This value is stored in plaintext in sdkconfig and the firmware.
            Do not commit credentials. Leave empty for an open test network.

    config UECHO_EXAMPLE_LED_GPIO
        int "LED GPIO number (-1 to disable)"
        range -1 48
        default -1
        help
            GPIO driven high while the light's operation status (EPC 0x80)
            is ON (0x30). Set -1 to only log the status.

    config UECHO_EXAMPLE_MANUFACTURER_CODE
        hex "Manufacturer code"
        range 0x000000 0xFFFFFF
        default 0xFFFFF0
        help
            ECHONET Lite manufacturer code. 0xFFFFF0 is reserved for
            experimental use; set your assigned code for products.

endmenu
```
